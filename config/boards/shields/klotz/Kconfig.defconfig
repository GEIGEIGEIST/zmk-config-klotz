## config/boards/shields/klotz/Kconfig.defconfig
```kconfig
if SHIELD_KLOTZ_LEFT

config ZMK_KEYBOARD_NAME
    default "KLOTZ"

config ZMK_SPLIT_BLE_ROLE_CENTRAL
    default y

endif

if SHIELD_KLOTZ_LEFT || SHIELD_KLOTZ_RIGHT

config ZMK_SPLIT
    default y

endif
```
